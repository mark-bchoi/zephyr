/*
 * Copyright (c) 2023 Espressif Systems (Shanghai) Co., Ltd.
 *
 * SPDX-License-Identifier: Apache-2.0
 */
/dts-v1/;

#include <espressif/esp32s3/esp32s3_wroom_n16r8.dtsi>
//#include <espressif/partitions_0x0_amp.dtsi>
#include <espressif/partitions_0x0_amp_16M.dtsi>
//#include <espressif/partitions_0x1000_default_16M.dtsi>
//#include <espressif/partitions_0x1000_amp_16M.dtsi>
#include "esp32s3_wroom1_n16r8-pinctrl.dtsi"

/ {
	model = "Espressif ESP32S3-WROOM1-N16R8 APPCPU";
	compatible = "espressif,esp32s3";

	chosen {
		zephyr,sram = &sram1;
		zephyr,ipc_shm = &shm0;
		zephyr,ipc = &ipm0;
		zephyr,flash = &flash0;
		zephyr,code-partition = &slot0_appcpu_partition;
	};
};

&trng0 {
	status = "okay";
};

&ipm0 {
	status = "okay";
};
