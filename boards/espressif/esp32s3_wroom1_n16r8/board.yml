## boards/espressif/esp32s3_wroom1_n16r8/board.yml
```yaml
board:
  name: esp32s3_wroom1_n16r8
  full_name: ESP32S3-WROOM1_N16R8
  vendor: espressif
  socs:
  - name: esp32s3
```

## boards/espressif/esp32s3_wroom1_n16r8/esp32s3_wroom1_n16r8_procpu_defconfig
```kconfig
# SPDX-License-Identifier: Apache-2.0

CONFIG_CONSOLE=y
CONFIG_SERIAL=y
CONFIG_UART_CONSOLE=y
CONFIG_GPIO=y
CONFIG_CLOCK_CONTROL=y


CONFIG_LOG=y
CONFIG_ESP_SPIRAM=y
CONFIG_SHARED_MULTI_HEAP=y
CONFIG_SPIRAM_MODE_OCT=y
CONFIG_SPIRAM_SPEED_80M=y
CONFIG_ESP32S3_DATA_CACHE_64KB=y
CONFIG_ESP_SPIRAM_MEMTEST=y
```
